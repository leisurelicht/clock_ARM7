/********************************************************************************************************
- FB-EDU-PARM-LPC2138 User Function file
-
- Author: Luo XieBing 
-
- Date: 2009-05-18
-
- Guangzhou Windway Electronic Technology Co., Ltd.
********************************************************************************************************/

/****************************************************************************
* 文件名：PWM_Music.C
* 功能：利用PWM的方式控制音乐频率，播放歌曲彩虹妹妹
****************************************************************************/
#include "PWM_Music.h"
// 以4分音符为1拍
#define TEMPO   8
#define _1      TEMPO*4     //全音符
#define _1d     TEMPO*6     //附点全音符
#define _2      TEMPO*2     //二音符
#define _2d     TEMPO*3     //附点二音符
#define _4      TEMPO*1     //四分音符
#define _4d     TEMPO*3/2   //附点四分音符
#define _8      TEMPO*1/2   //八分音符
#define _8d     TEMPO*3/4   //附点八分音符
#define _16     TEMPO*1/4   //十六分音符
#define _16d    TEMPO*3/8   //附点十六分音符
#define _32     TEMPO*1/8   //32分音符

#define _1DO    1000000/(262*2)
#define _1RE    1000000/(294*2)
#define _1MI    1000000/(330*2)
#define _1FA    1000000/(349*2)
#define _1SO    1000000/(392*2)
#define _1LA    1000000/(440*2)
#define _1TI    1000000/(494*2)

#define _DO    1000000/(523*2)
#define _RE    1000000/(587*2)
#define _MI    1000000/(659*2)
#define _FA    1000000/(698*2)
#define _SO    1000000/(784*2)
#define _LA    1000000/(880*2)
#define _TI    1000000/(988*2)

#define _DO1    1000000/(1047*2)
#define _RE1    1000000/(1175*2)
#define _MI1    1000000/(1319*2)
#define _FA1    1000000/(1397*2)
#define _SO1    1000000/(1568*2)
#define _LA1    1000000/(1760*2)
#define _TI1    1000000/(1976*2)
#/* 歌曲曲谱 － 虹彩妹妹*/
const uint32 HCMM[] =
{
	_LA, _SO, _MI, _LA, _SO, _MI,
	_LA, _LA, _SO, _LA,
	_LA, _SO, _MI, _LA, _SO, _MI,
	_RE, _RE, _DO, _RE,
	_MI, _MI, _SO, _LA, _DO1, _LA, _SO,
	_MI, _MI, _SO, _DO,
	_MI, _MI, _MI, _MI, _MI,
	_1LA,_1LA,_1SO,_1LA,
};

/* 歌曲节拍 */
const uint32 HCMM_L[] =
{
	_4, _8, _8, _4, _8, _8,
	_8, _4, _8, _2,
	_4, _8, _8, _4, _8, _8,
	_8, _4, _8, _2,
	_4, _8, _8, _8, _8, _8, _8,
	_8, _4, _8, _2,
	_4, _4, _4, _8, _8,
	_8, _4, _8, _2,
};


/*
********************************************************************************************************
** 函数名称: Delay
** 功能描述: 软件延时函数
*******************************************************************************************************
*/
void Delay(uint8 dly)
{
    uint32 i;
    
    for(; dly > 0; dly--)
        for(i = 0; i < 0x7FFFF; i++);
}


/****************************************************************************
* 名称：main()
* 功能：每按一次键，对相应的LED进行取反
****************************************************************************/
void  music(void)
{ 
     TargetResetInit();
    uint8 i;
    
    PINSEL0  = 0x02 << 14;		// P0.7选择PWM2功能
    
    /* PWM初始化 */
    PWMPR    = 0x00;		    // 不分频，计数频率为Fpclk
    PWMMCR   = 0x02;			// 设置PWMMR0匹配时复位PWMTC
    PWMPCR   = 0x0400;			// 允许PWM2输出，单边PWM
    PWMMR0   = Fpclk / 2000;
    PWMMR2   = PWMMR0 / 2;		// 50%占空比
    PWMLER   = 0x05;			// PWM0和PWM2匹配锁存
    PWMTCR   = 0x02;            // 复位PWMTC
    PWMTCR   = 0x09;            // 启动PWM输出

    while(1)
    {
        for(i = 0; i < sizeof(HCMM); i++)
        {
         	PWMMR0   = Fpclk / HCMM[i]; // 设置输出频率
		PWMLER   = 0x05;		    // 更新匹配值后，必须锁存
            Delay(HCMM_L[i]);			// 延时，控制播放速度
        }
    }

 
}

