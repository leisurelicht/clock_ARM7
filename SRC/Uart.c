#include "Uart.h"




#define  UART_BPS	9600			/* 定义通讯波特率 */
 char  str[20]={"IT IS GOOD!"};
/****************************************************************************
* 名称：UART0_Ini()
* 功能：初始化串口0。
*        P0.0和P0.1连接到UART, 设置为8位数据位，1位停止位，无奇偶校验，波特率为9600
* 入口参数：无
* 出口参数：无
****************************************************************************/
void  UART0_Init(void)
{
   uint16 Fdiv;

   PINSEL0 &= 0x0FFFFFF0;
   PINSEL0 |= 0x00000005;		     // 设置I/O连接到UART0

   U0LCR = 1 << LCR_DLAB_BIT |               // DLAB = 1，可设置波特率
           WordLength8 << LCR_WORDLENTH_BIT; // WordLenth = 3, 8位数据位
   Fdiv = (Fpclk >> 4) / UART_BPS;           // 设置波特率
   U0DLM = (Fdiv & 0xFF00) >> 8;	     // 设置分频寄存器高字节					
   U0DLL = Fdiv & 0x00FF;		     // 设置分频寄存器低字节					
   U0LCR = 0x03;
}

/****************************************************************************
* 名称：UART0_SendByte()
* 功能：向串口发送字节数据，并等待发送完毕。
* 入口参数：data		要发送的数据
* 出口参数：无
****************************************************************************/
void  UART0_SendByte(uint8 data)
{
   U0THR = data;				    // 发送数据
   while ((U0LSR&0x20)==0)  ;			    // 等待数据发送完毕
}


/****************************************************************************
* 名称：UART0_SendStr()
* 功能：向串口发送一字符串
* 入口参数：srt		要发送的字符串的指针
* 出口参数：无
****************************************************************************/

void  ISendStr(char *str)
{  while(1)
   {  if(*str=='\0') break;                  // 若为'\0'，则退出
      UART0_SendByte(*str++);                // 发送显示数据
   }
}

void Uart_Print()
{
     
      sprintf(str, "NOW\r\n %4d年%4d月%4d号%4星期%d%4d点%4d分%4d秒 \r\n", YEAR,MONTH,DOM,DOW,HOUR,MIN,SEC);
      ISendStr(str); 
      U0THR=0x00;
}

